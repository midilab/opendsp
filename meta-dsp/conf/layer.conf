## meta-dsp/conf/layer.conf
```bitbake
BBPATH .= ":${LAYERDIR}"
BBFILES += "${LAYERDIR}/recipes-*/*/*.bb \
            ${LAYERDIR}/recipes-*/*/*.bbappend"

BBFILE_COLLECTIONS += "meta-dsp"
BBFILE_PATTERN_meta-dsp := "^${LAYERDIR}/"
BBFILE_PRIORITY_meta-dsp = "20"

# ffmpeg4-layer: https://github.com/schnitzeltony/meta-ffmpeg4
#LAYERDEPENDS_meta-dsp = " \
#    core \
#    openembedded-layer \
#    multimedia-layer \
#    ffmpeg4-layer \
#    networking-layer \
#    xfce-layer \
#    gnome-layer \
#    meta-python \
#    qt5-layer \
#"

LAYERSERIES_COMPAT_meta-dsp = "walnascar"
```

## meta-opendsp/conf/bblayers.conf.sample
```bitbake
POKY_BBLAYERS_CONF_VERSION = "2"

BBPATH = "${TOPDIR}"
BBFILES ?= ""

BBLAYERS ?= " \
    ##OEROOT##/meta \
    ##OEROOT##/meta-poky \
    ##OEROOT##/meta-yocto-bsp \
    ##OEROOT##/meta-openembedded/meta-oe \
    ##OEROOT##/meta-openembedded/meta-python \
    ##OEROOT##/meta-openembedded/meta-networking \
    ##OEROOT##/meta-openembedded/meta-multimedia \
    ##OEROOT##/meta-raspberrypi \
    ##OEROOT##/meta-opendsp \
"

# BBLAYERS += "##OEROOT##/meta-qt5 "
```

## meta-opendsp/conf/distro/opendsp.conf
```bitbake
#@--------------------------------------------------------------------
#@TYPE: Distribution
#@NAME: Opendsp
#@DESCRIPTION: Linux Distribution for audio
#@MAINTAINER: Romulo Silva <contact@midilab.co>
#@--------------------------------------------------------------------

require conf/distro/poky.conf

DISTRO = "opendsp"
DISTRO_NAME = "Opendsp"
DISTRO_VERSION = "1.0.0"

MAINTAINER = "midilab"
TARGET_VENDOR = "-midilab"
LOCALCONF_VERSION = "2"

# directfb, opengl, usbhost
DISTRO_FEATURES += " systemd alsa smbfs x11 wifi qt5 opengl"
DISTRO_FEATURES_BACKFILL_CONSIDERED += "sysvinit"
DISTRO_FEATURES:remove = "wayland"
#DISTRO_FEATURES:remove:mx7d = "opengl"

VIRTUAL-RUNTIME_init_manager = "systemd"
VIRTUAL-RUNTIME_initscripts = "systemd-compat-units"

# Kernel setup
KERNEL_MODULE_AUTOLOAD += " cpufreq_performance"
# RT Kernel setup
#PREFERRED_PROVIDER_virtual/kernel = "linux-yocto-rt"
#PREFERRED_VERSION_linux-yocto-rt = "5.15%"
# Enable high-resolution timers and other RT features
#DISTRO_FEATURES:append = " rt"
# Use a more aggressive CPU governor
# "standard", "tiny", and "preempt-rt"
#LINUX_KERNEL_TYPE="preempt-rt"
# Optional: Configure for low-latency
#IMAGE_INSTALL:append = " rt-tests stress-ng"
# RT-specific kernel parameters
#APPEND += "isolcpus=1,2,3 nohz_full=1,2,3 rcu_nocbs=1,2,3 threadirqs"
# Low latency safe parameters
#APPEND += " threadirqs"

# Example with feed names for opkg (name is first part)
#PACKAGE_FEED_URIS = " \
#    opendsp-base http://packages.mycorp.com/feeds/${DISTRO_CODENAME}/base/${MACHINE} \
#    opendsp-custom http://packages.mycorp.com/feeds/${DISTRO_CODENAME}/custom/${MACHINE} \
#    opendsp-all http://packages.mycorp.com/feeds/${DISTRO_CODENAME}/all \
#"
# Assumes web server runs in tmp/deploy/ipk
PACKAGE_FEED_URIS = "dev-feed http://opendsp.midilab.co/${MACHINE}"
```

## meta-opendsp/conf/layer.conf
```bitbake
# We have a conf and classes directory, add to BBPATH
BBPATH .= ":${LAYERDIR}"

# We have recipes-* directories, add to BBFILES
BBFILES += "${LAYERDIR}/recipes-*/*/*.bb \
    ${LAYERDIR}/recipes-*/*/*.bbappend"

BBFILE_COLLECTIONS += "meta-opendsp"
BBFILE_PATTERN_meta-opendsp := "^${LAYERDIR}/"
BBFILE_PRIORITY_meta-opendsp = "10"

LAYERSERIES_COMPAT_meta-opendsp = "kirkstone"
LAYERDEPENDS_meta-opendsp = "core meta-dsp"
# openembedded-layer networking-layer"

# cause compatibility issues with other layers
LAYERVERSION_meta-opendsp = "1"
```

## meta-opendsp/conf/local.conf.sample
```bitbake
# You can chose your machine via env var at compile time
# MACHINE=raspberrypi3 bitbake opendsp-base-image
# or...
# export MACHINE=raspberrypi3
# Chose only one!
# 32 bit Intel Core 2 CPU (and later) with MMX, SSE, SSE2, SSE3, and SSSE3 instruction set support. Supports a moderately wide range of drivers that should boot and be usable on "typical" hardware.
#MACHINE ??= "intel-core2-32"
# 64 bit Intel Core i7 CPU (and later) with MMX, SSE, SSE2, SSE3, and SSSE3 instruction set support. Supports a moderately wide range of drivers that should boot and be usable on "typical" hardware.
MACHINE ??= "intel-corei7-64"
# 64 bit Intel Skylake CPU (and later) with MMX, SSE, SSE2, SSE3, SSE4.1, SSE4.2, AVX, and AVX2 instruction set support. Supports a moderately wide range of drivers that should boot and be usable on "typical" hardware.
#MACHINE ??= "intel-skylake-64"
# Raspberry PI 2/3
#MACHINE ??= "raspberrypi3"

DISTRO = "opendsp"

# pam is needed for samba
DISTRO_FEATURES:append = " pam x11 systemd"

PACKAGE_CLASSES ?= "package_ipk"

#
# SDK target architecture
#
# This variable specifies the architecture to build SDK items for and means
# you can build the SDK packages for architectures other than the machine you are
# running the build on (i.e. building i686 packages on an x86_64 host).
# Supported values are i686, x86_64, aarch64
#SDKMACHINE ?= "i686"

#
# Extra image configuration defaults
#
# The EXTRA_IMAGE_FEATURES variable allows extra packages to be added to the generated
# images. Some of these options are added to certain image types automatically. The
# variable can contain the following options:
#  "dbg-pkgs"       - add -dbg packages for all installed packages
#                     (adds symbol information for debugging/profiling)
#  "src-pkgs"       - add -src packages for all installed packages
#                     (adds source code for debugging)
#  "dev-pkgs"       - add -dev packages for all installed packages
#                     (useful if you want to develop against libs in the image)
#  "ptest-pkgs"     - add -ptest packages for all ptest-enabled packages
#                     (useful if you want to run the package test suites)
#  "tools-sdk"      - add development tools (gcc, make, pkgconfig etc.)
#  "tools-debug"    - add debugging tools (gdb, strace)
#  "eclipse-debug"  - add Eclipse remote debugging support
#  "tools-profile"  - add profiling tools (oprofile, lttng, valgrind)
#  "tools-testapps" - add useful testing tools (ts_print, aplay, arecord etc.)
#  "debug-tweaks"   - make an image suitable for development
#                     e.g. ssh root access has a blank password
# There are other application targets that can be used here too, see
# meta/classes/image.bbclass and meta/classes/core-image.bbclass for more details.
# We default to enabling the debugging tweaks.
EXTRA_IMAGE_FEATURES ?= ""

#
# Additional image features
#
# The following is a list of additional classes to use when building images which
# enable extra features. Some available options which can be included in this variable
# are:
#   - 'buildstats' collect build statistics
USER_CLASSES ?= "buildstats"

#
# Runtime testing of images
#
# The build system can test booting virtual machine images under qemu (an emulator)
# after any root filesystems are created and run tests against those images. It can also
# run tests against any SDK that are built. To enable this uncomment these lines.
# See classes/test{image,sdk}.bbclass for further details.
#IMAGE_CLASSES += "testimage testsdk"
#TESTIMAGE_AUTO:qemuall = "1"

#
# Interactive shell configuration
#
# Under certain circumstances the system may need input from you and to do this it
# can launch an interactive shell. It needs to do this since the build is
# multithreaded and needs to be able to handle the case where more than one parallel
# process may require the user's attention. The default is iterate over the available
# terminal types to find one that works.
#
# Examples of the occasions this may happen are when resolving patches which cannot
# be applied, to use the devshell or the kernel menuconfig
#
# Supported values are auto, gnome, xfce, rxvt, screen, konsole (KDE 3.x only), none
# Note: currently, Konsole support only works for KDE 3.x due to the way
# newer Konsole versions behave
#OE_TERMINAL = "auto"
# By default disable interactive patch resolution (tasks will just fail instead):
PATCHRESOLVE = "noop"

#
# Disk Space Monitoring during the build
#
# Monitor the disk space during the build. If there is less that 1GB of space or less
# than 100K inodes in any key build location (TMPDIR, DL_DIR, SSTATE_DIR), gracefully
# shutdown the build. If there is less than 100MB or 1K inodes, perform a hard halt
# of the build. The reason for this is that running completely out of space can corrupt
# files and damages the build in ways which may not be easily recoverable.
# It's necessary to monitor /tmp, if there is no space left the build will fail
# with very exotic errors.
BB_DISKMON_DIRS ??= "\
    STOPTASKS,${TMPDIR},1G,100K \
    STOPTASKS,${DL_DIR},1G,100K \
    STOPTASKS,${SSTATE_DIR},1G,100K \
    STOPTASKS,/tmp,100M,100K \
    HALT,${TMPDIR},100M,1K \
    HALT,${DL_DIR},100M,1K \
    HALT,${SSTATE_DIR},100M,1K \
    HALT,/tmp,10M,1K"

#
# Shared-state files from other locations
#
# As mentioned above, shared state files are prebuilt cache data objects which can be
# used to accelerate build time. This variable can be used to configure the system
# to search other mirror locations for these objects before it builds the data itself.
#
# This can be a filesystem directory, or a remote url such as https or ftp. These
# would contain the sstate-cache results from previous builds (possibly from other
# machines). This variable works like fetcher MIRRORS/PREMIRRORS and points to the
# cache locations to check for the shared objects.
# NOTE: if the mirror uses the same structure as SSTATE_DIR, you need to add PATH
# at the end as shown in the examples below. This will be substituted with the
# correct path within the directory structure.
#SSTATE_MIRRORS ?= "\
#file://.* https://someserver.tld/share/sstate/PATH;downloadfilename=PATH \
#file://.* file:///some/local/dir/sstate/PATH"

#
# Yocto Project SState Mirror
#
# The Yocto Project has prebuilt artefacts available for its releases, you can enable
# use of these by uncommenting the following lines. This will mean the build uses
# the network to check for artefacts at the start of builds, which does slow it down
# equally, it will also speed up the builds by not having to build things if they are
# present in the cache. It assumes you can download something faster than you can build it
# which will depend on your network.
# Note: For this to work you also need hash-equivalence passthrough to the matching server
#
#BB_HASHSERVE_UPSTREAM = "hashserv.yocto.io:8687"
#SSTATE_MIRRORS ?= "file://.* http://sstate.yoctoproject.org/all/PATH;downloadfilename=PATH"

#
# Qemu configuration
#
# By default native qemu will build with a builtin VNC server where graphical output can be
# seen. The line below enables the SDL UI frontend too.
PACKAGECONFIG:append:pn-qemu-system-native = " sdl"
# By default libsdl2-native will be built, if you want to use your host's libSDL instead of
# the minimal libsdl built by libsdl2-native then uncomment the ASSUME_PROVIDED line below.
#ASSUME_PROVIDED += "libsdl2-native"

# You can also enable the Gtk UI frontend, which takes somewhat longer to build, but adds
# a handy set of menus for controlling the emulator.
#PACKAGECONFIG:append:pn-qemu-system-native = " gtk+"

#
# Hash Equivalence
#
# Enable support for automatically running a local hash equivalence server and
# instruct bitbake to use a hash equivalence aware signature generator. Hash
# equivalence improves reuse of sstate by detecting when a given sstate
# artifact can be reused as equivalent, even if the current task hash doesn't
# match the one that generated the artifact.
#
# A shared hash equivalent server can be set with "<HOSTNAME>:<PORT>" format
#
#BB_HASHSERVE = "auto"
#BB_SIGNATURE_HANDLER = "OEEquivHash"

#
# Memory Resident Bitbake
#
# Bitbake's server component can stay in memory after the UI for the current command
# has completed. This means subsequent commands can run faster since there is no need
# for bitbake to reload cache files and so on. Number is in seconds, after which the
# server will shut down.
#
#BB_SERVER_TIMEOUT = "60"

# CONF_VERSION is increased each time build/conf/ changes incompatibly and is used to
# track the version of this file when it was generated. This can safely be ignored if
# this doesn't mean anything to you.
CONF_VERSION = "2"
```

## meta-opendsp/wic/intel-corei7-64.wks
```
# Create a live self-installer disk image
# populate content to install using IMAGE_BOOT_FILES
part /boot --source bootimg-efi --sourceparams="loader=grub-efi, title=boot, label=boot-efi, initrd=${INITRD_IMAGE_LIVE}-${MACHINE}.${INITRAMFS_FSTYPES}" --ondisk sda --label boot --align 1024 --use-uuid --active
part / --source rootfs --rootfs-dir=${IMAGE_ROOTFS} --ondisk sda --label opendsp --align 1024 --use-uuid --fstype=ext4
# user data
part /home/opendsp/data --source rootfs --rootfs-dir=${IMAGE_ROOTFS}/home/opendsp/data --ondisk sda --fstype=ext4 --label data --align 1024 --use-uuid --size 128M

bootloader --ptable gpt --timeout=0 --append=" rootwait "
```

## meta-opendsp/wic/raspberrypi.wks
```
# short-description: Create Raspberry Pi SD card image
# long-description: Creates a partitioned SD card image for use with
# Raspberry Pi. Boot files are located in the first vfat partition.

part /boot --source bootimg-partition --ondisk mmcblk0 --fstype=vfat --label boot --active --align 4096 --size 20
part / --source rootfs --ondisk mmcblk0 --fstype=ext4 --label root --align 4096
# added by opendsp
part /home/opendsp/data --source rootfs --rootfs-dir=${IMAGE_ROOTFS}/home/opendsp/data --ondisk mmcblk0 --fstype=ext4 --label data --align 4096 --size 256M

# console=null fsck.repair=yes dwc_otg.speed=1 quiet logo.nologo consoleblank=0
bootloader --append="fsck.repair=yes dwc_otg.speed=1"
```

## meta-video/conf/layer.conf
```bitbake
BBPATH .= ":${LAYERDIR}"
BBFILES += "${LAYERDIR}/recipes-*/*/*.bb \
            ${LAYERDIR}/recipes-*/*/*.bbappend"

BBFILE_COLLECTIONS += "meta-video"
BBFILE_PATTERN_meta-video := "^${LAYERDIR}/"
BBFILE_PRIORITY_meta-video = "30"

#LAYERDEPENDS_meta-video = " \
#    core \
#    openembedded-layer \
#    multimedia-layer \
#    ffmpeg4-layer \
#    networking-layer \
#    xfce-layer \
#    gnome-layer \
#    meta-python \
#    qt5-layer \
#"

LAYERSERIES_COMPAT_meta-video = "kirkstone"
```
